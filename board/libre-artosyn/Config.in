## board/libre-artosyn/Config.in
```kconfig
menu "Libre Artosyn"
source "$BR2_EXTERNAL_LIBRE_ARTOSYN_PATH/package/ar813x_loadmodule/Config.in"
endmenu
```

## board/libre-artosyn/configs/libre_artosyn_defconfig
```kconfig
BR2_aarch64=y
BR2_KERNEL_HEADERS_5_10=y
BR2_PACKAGE_GLIBC_KERNEL_COMPAT=y
BR2_TARGET_GENERIC_HOSTNAME="libre-artosyn"
BR2_TARGET_GENERIC_ISSUE="Libre Artosyn"
BR2_ROOTFS_DEVICE_CREATION_DYNAMIC_MDEV=y
BR2_SYSTEM_BIN_SH_BASH=y
# BR2_TARGET_GENERIC_REMOUNT_ROOTFS_RW is not set
BR2_ROOTFS_OVERLAY="$(BR2_EXTERNAL_LIBRE_ARTOSYN_PATH)/board/libre-artosyn/overlay"
BR2_ROOTFS_POST_IMAGE_SCRIPT="$(BR2_EXTERNAL_LIBRE_ARTOSYN_PATH)/board/libre-artosyn/post_image.sh"
BR2_PACKAGE_BUSYBOX_CONFIG="$(BR2_EXTERNAL_LIBRE_ARTOSYN_PATH)/configs/libre-artosyn-busybox.config"
BR2_PACKAGE_BUSYBOX_SHOW_OTHERS=y
BR2_PACKAGE_FFMPEG=y
BR2_PACKAGE_FFMPEG_SWSCALE=y
BR2_PACKAGE_STRACE=y
BR2_PACKAGE_ZLIB=y
BR2_PACKAGE_LIBFUSE3=y
BR2_PACKAGE_CJSON=y
BR2_PACKAGE_CJSON_UTILS=y
BR2_TARGET_ROOTFS_SQUASHFS=y
BR2_TARGET_ROOTFS_SQUASHFS4_LZ4=y
# BR2_TARGET_ROOTFS_TAR is not set
```

## board/libre-artosyn/package/ar813x_loadmodule/Config.in
```kconfig
config BR2_PACKAGE_AR813X_LOADMODULE
	bool "ar813x_loadmodule"
	help
	  Build and install the ar813x_loadmodule userspace utility.
```
